## conf/distro/rpi5.conf
```bitbake
DISTRO_NAME = "RPI5"
DISTRO_VERSION = "0.1"
INIT_MANAGER = "systemd"
PACKAGE_CLASSES ?= "package_ipk"
ENABLE_RUST = "1"
```

## conf/layer.conf
```bitbake
# We have a conf and classes directory, add to BBPATH
BBPATH .= ":${LAYERDIR}"

# We have recipes-* directories, add to BBFILES
BBFILES += "${LAYERDIR}/recipes-*/*/*.bb \
            ${LAYERDIR}/recipes-*/*/*.bbappend"

BBFILE_COLLECTIONS += "meta-rpi5"
BBFILE_PATTERN_meta-rpi5 = "^${LAYERDIR}/"
BBFILE_PRIORITY_meta-rpi5 = "6"

LAYERDEPENDS_meta-rpi5 = "core"
LAYERSERIES_COMPAT_meta-rpi5 = "scarthgap"
```
